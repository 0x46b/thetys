## esp32/components/PlantManager/Kconfig
```kconfig
menu "Plant Manager Tasks"
     menu "Sensor Reading"
     config READING_TASK_STACK_DEPTH
     	  int "freeRTOS Stack Depth for the sensor reading task"
	  default 4096
     config READING_TASK_PRIORITY
     	  int "Priority for the sensor reading task"
	  default 4
     config READING_TASK_BUFFER_SIZE
     	    int "Buffer size for every reading task"
	    default 10
     endmenu
     menu "Data Handling"
     config DATA_TASK_STACK_DEPTH
     	  int "freeRTOS Stack Depth for the data handling task"
	  default 4096
     config DATA_TASK_PRIORITY
     	  int "Priority for the data handling task"
	  default 4
     endmenu
     menu "Pump Handling"
     config PUMP_TASK_STACK_DEPTH
     	  int "freeRTOS Stack Depth for the pump handling task"
	  default 4096
     config PUMP_TASK_PRIORITY
     	  int "Priority for the pump handling task"
	  default 4
     endmenu
endmenu
```

## esp32/components/RGBLEDDriver/Kconfig
```kconfig
menu "RGB LED"
     config RGB_LED_GPIO
     	    int "GPIO for controlling the on-board RGB-LED"
	    default 48
     help
     "GPIO where the RGB-LED is connected"
endmenu
```

## esp32/components/SensorDriver/Kconfig
```kconfig
menu "Humidity Sensor"
choice
    prompt "Select sensor attentuation"
    default ADC_ATTEN_DB_11
    help
        This option selects the attentuation for reading the sensor. It depends on the voltage range of the sensor. See the esp documentation for "ADC attentuation" for more information.

    config ADC_ATTEN_DB_0
         bool SENSOR_ATTEN_0
    config ADC_ATTEN_DB_2_5
         bool SENSOR_ATTEN_2_5
    config ADC_ATTEN_DB_6
         bool SENSOR_ATTEN_6
    config ADC_ATTEN_DB_11
         bool SENSOR_ATTEN_11

endchoice
endmenu
```

## esp32/components/SensorManager/Kconfig
```kconfig
menu "Thetys: Humidity Sensors"
     config MAX_SENSOR_COUNT
     	    int "Maximum number of sensors used"
     	    default 8
	    help
		Sets an upper limit of sensors that are supported

     config NUM_CALIBRATION_SAMPLES
     	    int "Number of readings for calibration"
	    default 50
	    help
		Calibration is done due many readings, which gets averaged. This is the number of readings to take per calibration

     config SENSOR_POLLING_TIME_IN_MS
    	   int "Polling time for the sensors in ms"
	   default 60000
	   help
		This configures the time between the sensor readings in milliseconds

    config SENSOR_POLLING_CORE
     	   int "Core the polling task should run on"
	   default 1
	   range 0 1
	   help
		The task for the sensor-polling will get executed on this CPU-core

    config SENSOR_WATER_REFERENCE_VALUE
    	   int "Raw value that is expected to get from the sensor if submerged in water (=100% humidity)"
	   default 4095

    config SENSOR_AIR_REFERENCE_VALUE
           int "Raw value that is expected to get from the sensor if no water at all (=0% humidity)"
	   default 0
endmenu
```

## esp32/components/UI/Kconfig
```kconfig
menu "Thetys: UI Settings"
  config ENABLE_UI
  bool "Enable/Disable UI on the LCD-screen"
  default "Enable/Disable UI on the LCD-screen"
  
  config NUMBER_OF_HISTORIC_MEASUREMENTS
  int "Number of historic measurements"
  default 125

  config LCD_DIN
  int "GPIO for the LCD DIN/MISO"
  default 11

  config LCD_CLK
  int "GPIO for the LCD CLK"
  default 12

  config LCD_CS
  int "GPIO for the LCD CS"
  default 10

  config LCD_DC
  int "GPIO for the LCD DC"
  default 9

  config LCD_RST
  int "GPIO for the LCD RST"
  default 46

  config LCD_BL
  int "GPIO for the LCD BL (Backlight)"
  default 13   
endmenu
```

## esp32/main/Kconfig
```kconfig
menu "Thetys watering system"
     config ENABLE_UI
     	    bool "Enable/Disable UI on the LCD-screen"
endmenu
```
